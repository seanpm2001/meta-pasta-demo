## conf/distro/include/torizon-override.inc
```bitbake
DISTRO_FEATURES_NATIVE_append = " x11 "
DISTRO_FEATURES_NATIVESDK_append = " x11 "

DISTRO_FEATURES_append = " alsa wayland x11 opengl vulkan "
```

## conf/layer.conf
```bitbake
# We might have a conf and classes directory, append to BBPATH
BBPATH .= ":${LAYERDIR}"

# We have a recipes directory, add to BBFILES
BBFILES += "${LAYERDIR}/recipes*/*/*.bb ${LAYERDIR}/recipes*/*/*.bbappend"

BBFILE_COLLECTIONS += "meta-pasta-demo"
BBFILE_PATTERN_meta-pasta-demo := "^${LAYERDIR}/"
BBFILE_PRIORITY_meta-pasta-demo = "90"

LAYERDEPENDS_meta-pasta-demo = "toradex-torizon-layer toradex-bsp-common-layer"
LAYERSERIES_COMPAT_meta-toradex-torizon = "thud warrior"
```
